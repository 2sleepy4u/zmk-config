#include <dt-bindings/zmk/matrix_transform.h>

/ {
    chosen {
        zmk,kscan = &kscan0;
    };

    kscan0: kscan {
        compatible = "zmk,kscan-gpio-direct";
        wakeup-source;

        input-gpios
            = <&gpio0 6  (GPIO_ACTIVE_LOW | GPIO_PULL_UP)>   /* key 1 */
            , <&gpio0 7  (GPIO_ACTIVE_LOW | GPIO_PULL_UP)>   /* key 2 */
            , <&gpio0 8  (GPIO_ACTIVE_LOW | GPIO_PULL_UP)>   /* key 3 */
            , <&gpio0 9  (GPIO_ACTIVE_LOW | GPIO_PULL_UP)>   /* key 4 */
            , <&gpio0 10 (GPIO_ACTIVE_LOW | GPIO_PULL_UP)>   /* key 5 */
            , <&gpio0 11 (GPIO_ACTIVE_LOW | GPIO_PULL_UP)>   /* key 6 */
            , <&gpio0 12 (GPIO_ACTIVE_LOW | GPIO_PULL_UP)>   /* key 7 */
            , <&gpio0 13 (GPIO_ACTIVE_LOW | GPIO_PULL_UP)>   /* key 8 */
            , <&gpio0 14 (GPIO_ACTIVE_LOW | GPIO_PULL_UP)>   /* key 9 */
            ;
    };
};
